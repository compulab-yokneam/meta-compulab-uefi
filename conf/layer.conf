## conf/layer.conf
```bitbake
# We have a conf and classes directory, add to BBPATH
BBPATH .= ":${LAYERDIR}"

# We have recipes-* directories, add to BBFILES
BBFILES += "${LAYERDIR}/recipes-*/*/*.bb \
            ${LAYERDIR}/recipes-*/*/*.bbappend"

BBFILE_COLLECTIONS += "compulab-uefi"
BBFILE_PATTERN_compulab-uefi = "^${LAYERDIR}/"
BBFILE_PRIORITY_compulab-uefi = "10"

LAYERSERIES_COMPAT_compulab-uefi = "zeus dunfell gatesgarth hardknott honister honister honister kirkstone "

CORE_IMAGE_EXTRA_INSTALL:append = "\
    packagegroup-core-boot \
    packagegroup-core-full-cmdline \
"

# Build settings
IMAGE_INSTALL:append = " grub-efi grub-efi-env "
IMAGE_INSTALL:append = " grub-bootconf grub-bootmod "
IMAGE_INSTALL:append = " gptfdisk "

# As of now the boot device is the same for all mx8 devices
GRUB_ROOT_DEVICE = "/dev/mmcblk2p2"

# The device tree file to use in grub.cfg
GRUB_BOOT_DEVICETREE:mcm-imx8m-mini = "sbc-mcm-imx8m-mini.dtb"
GRUB_BOOT_DEVICETREE:ucm-imx8m-mini = "ucm-imx8m-mini.dtb"
GRUB_BOOT_DEVICETREE:ucm-imx8m-plus = "ucm-imx8m-plus.dtb"
GRUB_BOOT_DEVICETREE:som-imx8m-plus = "som-imx8m-plus.dtb"
GRUB_BOOT_DEVICETREE:iot-gate-imx8 = "sb-iotgimx8.dtb"
GRUB_BOOT_DEVICETREE:iot-gate-imx8plus = "iot-gate-imx8plus.dtb"

# uuidgen --md5  --namespace @dns --name PARTUUID_BOOT
PARTUUID_BOOT = "87044308-be1b-3f44-9faf-8c8861799575"
UUID_BOOT = "eb59dfa1"

PARTUUID   = "240418b9-2073-3a29-8069-53056296a513"
UUID = "7a76ca7b-a154-3ae4-8e58-c1686d8655f9"

PARTUUID_2   = "91b6080d-334f-3bc1-95f6-aff43061f8cb"
UUID_2 = "a65c79e7-4960-357e-887c-f2070f9ba397"

BBMASK += " meta-bsp-imx8mm/recipes-bsp/u-boot-scr/u-boot-script.bbappend "
BBMASK += " meta-compulab-bsp/meta-bsp/recipes-bsp/u-boot-scr/u-boot-script.bb "

WKS_FILE = "imx-efi-root-boot-bootpart.wks.in"
WKS_FILE_DEPENDS_BOOTLOADERS = "grub-efi"

HOSTTOOLS += " grub-editenv "
HOSTTOOLS += " uuidgen "
```
